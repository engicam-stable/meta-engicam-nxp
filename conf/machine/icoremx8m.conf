## conf/machine/icoremx8m.conf
```bitbake
#@TYPE: Machine
#@NAME: Engicam iCoreMX8M
#@SOC: i.MX8M
#@DESCRIPTION: Machine configuration for NXP Engicam iCoreMX8M
#@MAINTAINER: support@engicam.com

MACHINEOVERRIDES =. "mx8:mx8m:mx8mq:"

require conf/machine/include/imx-base.inc
require conf/machine/include/arm/arch-arm64.inc

MACHINE_FEATURES += " pci wifi bluetooth"
SOC_DEFAULT_IMAGE_FSTYPES = "sdcard"

KERNEL_DEVICETREE = "engicam/icoremx8m.dtb"


UBOOT_CONFIG ??= "sd"
UBOOT_CONFIG[sd] = "icore_mx8mm_defconfig"
SPL_BINARY = "spl/u-boot-spl.bin"

# Set DDR FIRMWARE
DDR_FIRMWARE_NAME = "lpddr4_pmu_train_1d_imem.bin lpddr4_pmu_train_1d_dmem.bin lpddr4_pmu_train_2d_imem.bin lpddr4_pmu_train_2d_dmem.bin"

# Set u-boot DTB
UBOOT_DTB_NAME = "icore-imx8mm.dtb"

# Set imx-mkimage boot target
IMXBOOT_TARGETS = "flash_spl_uboot"

# Set Serial console
SERIAL_CONSOLE = "115200 ttymxc0"

IMAGE_BOOTLOADER = "imx-boot"

BOOT_SPACE = "65536"
KBUILD_DEFCONFIG = "${S}/arch/arm64/configs/icoremx8m_defconfig"
LOADADDR = ""
UBOOT_SUFFIX = "bin"
UBOOT_MAKE_TARGET = ""
IMX_BOOT_SEEK = "33"
```

## conf/machine/icoremx8mm.conf
```bitbake
#@TYPE: Machine
#@NAME: Engicam iCoreMX8Mini
#@SOC: i.MX8MM
#@DESCRIPTION: Machine configuration for NXP Engicam iCoreMX8Mini
#@MAINTAINER: support@engicam.com

MACHINEOVERRIDES =. "mx8:mx8m:mx8mm:"

require conf/machine/include/imx-base.inc
require conf/machine/include/arm/arch-arm64.inc

MACHINE_FEATURES += " pci wifi bluetooth"
SOC_DEFAULT_IMAGE_FSTYPES = "sdcard"


KERNEL_DEVICETREE = "engicam/icore-imx8mm.dtb engicam/icore-imx8mm-ctouch2-amp10.dtb"


UBOOT_CONFIG ??= "sd"
UBOOT_CONFIG[sd] = "icore_mx8mm_defconfig"
SPL_BINARY = "spl/u-boot-spl.bin"

# Set DDR FIRMWARE
DDR_FIRMWARE_NAME = "lpddr4_pmu_train_1d_imem.bin lpddr4_pmu_train_1d_dmem.bin lpddr4_pmu_train_2d_imem.bin lpddr4_pmu_train_2d_dmem.bin"

# Set u-boot DTB
UBOOT_DTB_NAME = "icore-imx8mm.dtb"

# Set imx-mkimage boot target
IMXBOOT_TARGETS = "flash_spl_uboot"

# Set Serial console
SERIAL_CONSOLE = "115200 ttymxc1"

IMAGE_BOOTLOADER = "imx-boot"

BOOT_SPACE = "65536"
KBUILD_DEFCONFIG = "${S}/arch/arm64/configs/icoremx8mm_defconfig"
LOADADDR = ""
UBOOT_SUFFIX = "bin"
UBOOT_MAKE_TARGET = ""
IMX_BOOT_SEEK = "33"
```

## conf/machine/imx6dl-icore-edimm2.conf
```bitbake
#@TYPE: Machine
#@NAME: i.Core M6 DL on Edimm 2.0 Starter Kit
#@SOC: i.MX6DL
#@DESCRIPTION: Machine configuration for Engicam i.Core M6 DualLite on Edimm 2.0
#@MAINTAINER: Fabio Aiuto <fabio.aiuto@engicam.com>
#

MACHINEOVERRIDES =. "mx6q:mx6dl:"

require conf/machine/include/imx-base.inc
require conf/machine/include/arm/armv7a/tune-cortexa9.inc

KERNEL_DEVICETREE = " \
	imx6dl-icore-edimm-v2.dtb \
"

KERNEL_DEVICETREE:append:use-nxp-bsp = " \
	imx6dl-icore-edimm-v2.dtb \
"

IMX_KERNEL_CONFIG_AARCH32 ="imx6dl_icore_edimm2_defconfig"

### u-boot-imx settings ###
PREFERRED_PROVIDER_linux-imx-mfgtool:mx6-nxp-bsp = ""
PREFERRED_PROVIDER_virtual/kernel:mx6-nxp-bsp = "linux-engicam-imx"
PREFERRED_PROVIDER_virtual/bootloader:mx6-nxp-bsp = "u-boot-engicam"
PREFERRED_PROVIDER_u-boot:mx6-nxp-bsp = "u-boot-engicam"
KERNEL_IMAGETYPE:mx6-nxp-bsp = "zImage"

SPL_BINARY = ""
UBOOT_CONFIG??= "sd"

UBOOT_MAKE_TARGET = "u-boot.imx"
UBOOT_SUFFIX = "imx"

UBOOT_CONFIG[sd]	= "imx6dl_icore_edimm2_sd_defconfig,sdcard"
UBOOT_CONFIG[nand]	= "imx6dl_icore_edimm2_nand_defconfig,ubifs"

WKS_FILE = " \
    ${@bb.utils.contains('IMX_DEFAULT_BOOTLOADER', \
                         'u-boot-fslc', 'imx-uboot-spl-bootpart.wks.in', \
                                        'imx-uboot-bootpart.wks.in', d)}"

SERIAL_CONSOLES = "115200;ttymxc3"
MACHINE_FIRMWARE:append:mx6 = " linux-firmware-43430"
MACHINE_FEATURES += " pci wifi bluetooth bcm43430"
SOC_DEFAULT_IMAGE_FSTYPES = "wic tar.bz2"
```

## conf/machine/imx6dl-icore.conf
```bitbake
#@TYPE: Machine
#@NAME: i.Core M6 DL on Edimm 2.0 Starter Kit
#@SOC: i.MX6DL
#@DESCRIPTION: Machine configuration for Engicam i.Core M6 DualLite on Edimm 2.0
#@MAINTAINER: <support@engicam.com>
#

MACHINEOVERRIDES =. "mx6:mx6q:"

require conf/machine/include/imx-base.inc
require conf/machine/include/arm/armv7a/tune-cortexa9.inc

PREFERRED_PROVIDER_virtual/kernel:mx6-nxp-bsp = "linux-engicam"
PREFERRED_PROVIDER_linux-imx-mfgtool:mx6-nxp-bsp = ""
PREFERRED_PROVIDER_virtual/bootloader:mx6-nxp-bsp = "u-boot-engicam"
PREFERRED_PROVIDER_u-boot:mx6-nxp-bsp = "u-boot-engicam"

KERNEL_DEVICETREE += " \
	imx6dl-icore-starterkit-v2.dtb \
"

ENGICAM_KERNEL_CONFIG_AARCH32 ="imx6qdl_icore_starterkit2_defconfig"

### u-boot-imx settings ###
KERNEL_IMAGETYPE:mx6-nxp-bsp = "zImage"

SPL_BINARY = ""
UBOOT_CONFIG??= "sd"

UBOOT_MAKE_TARGET = "u-boot.imx"
UBOOT_SUFFIX = "imx"

UBOOT_CONFIG[sd]	= "imx6dl_icore_starterkit2_sd_defconfig,sdcard"
UBOOT_CONFIG[nand]	= "imx6dl_icore_starterkit2_nand_defconfig,ubifs"

WKS_FILE = " \
    ${@bb.utils.contains('IMX_DEFAULT_BOOTLOADER', \
                         'u-boot-fslc', 'imx-uboot-spl-bootpart.wks.in', \
                                        'imx-uboot-bootpart.wks.in', d)}"

SERIAL_CONSOLES = "115200;ttymxc3"
MACHINE_FIRMWARE:append:mx6 = " linux-firmware-43430"
MACHINE_FEATURES += " pci wifi bluetooth bcm43430"
```

## conf/machine/imx6qd-icore-edimm2.conf
```bitbake
#@TYPE: Machine
#@NAME: i.Core M6 QD on Edimm 2.0 Starter Kit
#@SOC: i.MX6DL
#@DESCRIPTION: Machine configuration for Engicam i.Core M6 Dual/Quad on Edimm 2.0
#@MAINTAINER: Fabio Aiuto <fabio.aiuto@engicam.com>
#

MACHINEOVERRIDES =. "mx6q:mx6dl:"

require conf/machine/include/imx-base.inc
require conf/machine/include/arm/armv7a/tune-cortexa9.inc

KERNEL_DEVICETREE = " \
	imx6q-icore-edimm-v2.dtb \
"

KERNEL_DEVICETREE:append:use-nxp-bsp = " \
	imx6q-icore-edimm-v2.dtb \
"

IMX_KERNEL_CONFIG_AARCH32 ="imx6qdl_icore_edimm2_defconfig"

### u-boot-imx settings ###
PREFERRED_PROVIDER_linux-imx-mfgtool:mx6-nxp-bsp = ""
PREFERRED_PROVIDER_virtual/kernel:mx6-nxp-bsp = "linux-engicam-imx"
PREFERRED_PROVIDER_virtual/bootloader:mx6-nxp-bsp = "u-boot-engicam"
PREFERRED_PROVIDER_u-boot:mx6-nxp-bsp = "u-boot-engicam"
KERNEL_IMAGETYPE:mx6-nxp-bsp = "zImage"

SPL_BINARY = ""
UBOOT_CONFIG??= "sd"

UBOOT_MAKE_TARGET = "u-boot.imx"
UBOOT_SUFFIX = "imx"

UBOOT_CONFIG[sd]	= "imx6q_icore_edimm2_sd_defconfig,sdcard"
UBOOT_CONFIG[nand]	= "imx6q_icore_edimm2_nand_defconfig,ubifs"

WKS_FILE = " \
    ${@bb.utils.contains('IMX_DEFAULT_BOOTLOADER', \
                         'u-boot-fslc', 'imx-uboot-spl-bootpart.wks.in', \
                                        'imx-uboot-bootpart.wks.in', d)}"

SERIAL_CONSOLES = "115200;ttymxc3"
MACHINE_FIRMWARE:append:mx6 = " linux-firmware-43430"
MACHINE_FEATURES += " pci wifi bluetooth bcm43430"
```

## conf/machine/imx6sx-icore.conf
```bitbake
#@TYPE: Machine
#@NAME: Engicam i.Core MX6SoloX
#@SOC: i.MX6SX
#@DESCRIPTION: Machine configuration for Engicam i.Core MX6SoloX
#@MAINTAINER: Support <support@engicam.com>

MACHINEOVERRIDES =. "mx6sx:mx6sx-icore:"

require conf/machine/include/imx-base.inc
require conf/machine/include/arm/armv7a/tune-cortexa9.inc

KERNEL_DEVICETREE = " \
    imx6sx-icore-ctouch2.dtb \
"
KERNEL_DEVICETREE:append:use-nxp-bsp = " \
    imx6sx-icore-ctouch2.dtb \
"

IMX_KERNEL_CONFIG_AARCH32 ="imx6sx_icore_defconfig"

### u-boot-imx settings ###
PREFERRED_PROVIDER_linux-imx-mfgtool:mx6-nxp-bsp = ""
PREFERRED_PROVIDER_virtual/kernel:mx6-nxp-bsp = "linux-engicam"
PREFERRED_PROVIDER_virtual/bootloader:mx6-nxp-bsp = "u-boot-engicam"
PREFERRED_PROVIDER_u-boot:mx6-nxp-bsp = "u-boot-engicam"
KERNEL_IMAGETYPE:mx6-nxp-bsp = "zImage"

UBOOT_MAKE_TARGET = "u-boot.imx"
UBOOT_SUFFIX = "imx"

UBOOT_CONFIG ??= " \
    sd \
    ${@bb.utils.contains('MACHINE_FEATURES', 'optee', 'sd-optee', '', d)} \
"

UBOOT_CONFIG[sd]    = "mx6sxicore_sd_defconfig,sdcard"
UBOOT_CONFIG[nand]    = "mx6sxicore_nand_defconfig,ubifs"

OPTEE_BIN_EXT = "6sxsdb"

SERIAL_CONSOLES = "115200;ttymxc4"

MACHINE_FEATURES += "pci wifi bluetooth bcm43430"
```

## conf/machine/imx6sx-smarcore.conf
```bitbake
#@TYPE: Machine
#@NAME: NXP i.MX6SoloX SabreSD
#@SOC: i.MX6SX
#@DESCRIPTION: Machine configuration for NXP i.MX6SoloX Sabre SD
#@MAINTAINER: Lauren Post <Lauren.Post@nxp.com>

MACHINEOVERRIDES =. "mx6sx:"

require conf/machine/include/imx-base.inc
require conf/machine/include/arm/armv7a/tune-cortexa9.inc

KERNEL_DEVICETREE = " \
    imx6sx-smarcore.dtb \
"
KERNEL_DEVICETREE:append:use-nxp-bsp = " \
    imx6sx-smarcore.dtb \
"

IMX_KERNEL_CONFIG_AARCH32 ="imx6sx_smarcore_defconfig"

### u-boot-imx settings ###
PREFERRED_PROVIDER_linux-imx-mfgtool:mx6-nxp-bsp = ""
PREFERRED_PROVIDER_virtual/kernel:mx6-nxp-bsp = "linux-engicam"
PREFERRED_PROVIDER_virtual/bootloader:mx6-nxp-bsp = "u-boot-engicam"
PREFERRED_PROVIDER_u-boot:mx6-nxp-bsp = "u-boot-engicam"
KERNEL_IMAGETYPE:mx6-nxp-bsp = "zImage"

UBOOT_MAKE_TARGET = "u-boot.imx"
UBOOT_SUFFIX = "imx"

UBOOT_CONFIG ??= " \
    sd \
    ${@bb.utils.contains('MACHINE_FEATURES', 'optee', 'sd-optee', '', d)} \
"

UBOOT_CONFIG[sd]    = "mx6sxsmarcore_defconfig,sdcard"

OPTEE_BIN_EXT = "6sxsdb"

SERIAL_CONSOLES = "115200;ttymxc4"

MACHINE_FIRMWARE:append:mx6 = " linux-firmware-ath6k"

MACHINE_FEATURES += "pci wifi bluetooth bcm4339 bcm43455"
```

## conf/machine/imx6ull-gea.conf
```bitbake
#@TYPE: Machine
#@NAME: Engicam Microgea
#@SOC: i.MX6ULL
#@DESCRIPTION: Machine configuration for Microgea i.MX6ULL microdev
#@MAINTAINER: engicam support <support@engicam.com>

MACHINEOVERRIDES =. "mx6:mx6ull:"

include conf/machine/include/imx-base.inc
include conf/machine/include/tune-cortexa7.inc

KERNEL_DEVICETREE = " imx6ull-gea-starterkit.dtb imx6ull-gea-loco7res.dtb"

UBOOT_CONFIG ??= "sd"
UBOOT_CONFIG[sd] = "gea_mx6ull_sd_defconfig,sdcard"
UBOOT_CONFIG[nand] = "gea_mx6ull_nand_defconfig"

SERIAL_CONSOLES = "115200;ttymxc0"

MACHINE_FEATURES = " wifi bluetooth bcm43430 alsa"

IMX_KERNEL_CONFIG_AARCH32_mx6ull = "gea_mx6ull_defconfig"
KBUILD_DEFCONFIG_mx6ull= "${IMX_KERNEL_CONFIG_AARCH32}"

IMAGE_BOOT_FILES = " \
    ${KERNEL_IMAGETYPE} \
    ${KERNEL_DEVICETREE} \
"

MACHINE_FIRMWARE_append = " linux-firmware-bcm43430"

MACHINE_EXTRA_RRECOMMENDS_remove =" kernel-module-nxp89xx "
```

## conf/machine/imx6ull-isiot.conf
```bitbake
#@TYPE: Machine
#@NAME: Engicam Microgea
#@SOC: i.MX6ULL
#@DESCRIPTION: Machine configuration for Microgea i.MX6ULL microdev
#@MAINTAINER: engicam support <support@engicam.com>

MACHINEOVERRIDES =. "mx6:mx6ull:"

include conf/machine/include/imx-base.inc
include conf/machine/include/tune-cortexa7.inc

KERNEL_DEVICETREE = "imx6ull-isiot.dtb"

UBOOT_CONFIG ??= "sd"
UBOOT_CONFIG[emmc] = "imx6ull_isiot_emmc_defconfig"
UBOOT_CONFIG[sd] = "imx6ull_isiot_sd_defconfig"

PREFERRED_PROVIDER_u-boot = "u-boot-engicam"
PREFERRED_PROVIDER_virtual/bootloader = "u-boot-engicam"
PREFERRED_PROVIDER_virtual/kernel = "linux-engicam"

SERIAL_CONSOLES = "115200;ttymxc0"

MACHINE_FEATURES += "wifi bluetooth"

IMX_KERNEL_CONFIG_AARCH32_mx6ull = "mx6ull_isiot_defconfig"

IMAGE_BOOT_FILES = " \
    ${KERNEL_IMAGETYPE} \
    ${KERNEL_DEVICETREE} \
"

MACHINE_FIRMWARE_append = " linux-firmware-bcm43430"
```

## conf/machine/imx8dx-icore.conf
```bitbake
#@TYPE: Machine
#@NAME: iCore Mx8x quad
#@SOC: i.MX8M quad
#@DESCRIPTION: Machine configuration for engicam iCore Mx8x quad
#@MAINTAINER: engicam support <support@engicam.com>


MACHINEOVERRIDES =. "mx8:mx8x:mx8qxp:mx8qxpc0:mx8qx:"

require conf/machine/include/imx-base.inc
require conf/machine/include/tune-cortexa35.inc

MACHINE_FEATURES_append =" pci wifi bluetooth "

# Don't include kernels in standard images
RDEPENDS_${KERNEL_PACKAGE_NAME}-base = ""

LOADADDR = ""

# We have to disable SERIAL_CONSOLE due to auto-serial-console
SERIAL_CONSOLES = "115200;ttyAMA0"

# we do not want to have getty running on tty1 as we run
# auto-serial-console there
USE_VT = "0"

KERNEL_DEVICETREE = " \
	engicam/imx8xd-icore-starterkit.dtb \	
"

IMX_KERNEL_CONFIG_AARCH64 = "imx8x_icore_defconfig"
KBUILD_DEFCONFIG_mx8= "${IMX_KERNEL_CONFIG_AARCH64}"

UBOOT_MAKE_TARGET = "u-boot.bin"
UBOOT_SUFFIX = "bin"
UBOOT_CONFIG ??= "sd"
UBOOT_CONFIG[sd] = "imx8xd_icore_defconfig,sdcard"

IMAGE_BOOTLOADER = "imx-boot"
IMX_BOOT_SEEK = "32"

IMXBOOT_TARGETS = \
    "${@bb.utils.contains('UBOOT_CONFIG',   'sd', 'flash', \
        bb.utils.contains('UBOOT_CONFIG', 'fspi', 'flash_flexspi', \
                                                  'UNKNOWN', d), d)}"

BOARD_TYPE = "icore"
```

## conf/machine/imx8mm-icore.conf
```bitbake
#@TYPE: Machine
#@NAME: NXP i.MX 8M Plus i.core
#@SOC: i.MX8MP
#@DESCRIPTION: Machine configuration for Engicam imx8mp-icore SOM
#@MAINTAINER: <support@engicam.com>

require include/imx8mm-icore.inc

MACHINEOVERRIDES =. "mx8-icore:"

KERNEL_DEVICETREE_BASENAME = "imx8mm-icore"

KERNEL_DEVICETREE:append:use-nxp-bsp = " \
	engicam/imx8mm-icore-starterkit.dtb \
    engicam/imx8mm-icore-ctouch2.dtb \
    engicam/imx8mm-icore-ctouch2-amp10.dtb \
"

UBOOT_CONFIG_BASENAME = "imx8mm_icore"
UBOOT_CONFIG ??= "1gb"
UBOOT_CONFIG[1gb] = "${UBOOT_CONFIG_BASENAME}_defconfig,sdcard"
UBOOT_CONFIG[2gb] = "${UBOOT_CONFIG_BASENAME}_2gb_defconfig,sdcard"


DDR_FIRMWARE_NAME = " \
	lpddr4_pmu_train_1d_imem.bin \
	lpddr4_pmu_train_1d_dmem.bin \
	lpddr4_pmu_train_2d_imem.bin \
	lpddr4_pmu_train_2d_dmem.bin \
"

IMXBOOT_TARGETS_BASENAME = "flash_evk"
IMX_DEFAULT_BSP = "nxp"

ENGICAM_KERNEL_CONFIG_AARCH64 = "imx8_icore_defconfig"
```

## conf/machine/imx8mp-icore-1gb.conf
```bitbake
#@TYPE: Machine
#@NAME: i.MX 8M Plus icore starterkit 
#@SOC: i.MX8MP
#@DESCRIPTION: Machine configuration for Engicam i.MX 8M Plus icore starterkit 
#@MAINTAINER: Engicam Support <support@engicam.com>

MACHINEOVERRIDES =. "imx-boot-container:mx8:mx8m:mx8mp:"

require conf/machine/include/imx-base.inc
require conf/machine/include/arm/armv8a/tune-cortexa53.inc

# Mainline BSP defaults to "generic" cortexa53 configuration,
# adjust it here to include crypto extension which enables
# inline NEON and FPU code generation
DEFAULTTUNE:use-mainline-bsp = "cortexa53-crypto"

MACHINE_FEATURES += "pci wifi bluetooth"

KERNEL_DEVICETREE_BASENAME = "imx8mp-icore-1gb-starterkit"

IMX_KERNEL_CONFIG_AARCH64="imx8_icore_defconfig"

# Mainline kernel contains only one DTB file for
# imx8mp-icore machine
KERNEL_DEVICETREE:use-nxp-bsp = " \
	engicam/imx8mp-icore-1gb-starterkit.dtb \
"

PREFERRED_PROVIDER_virtual/kernel:use-nxp-bsp = "linux-engicam"

# U-Boot configuration
PREFERRED_PROVIDER_virtual/bootloader:use-nxp-bsp = "u-boot-engicam"
IMX_DEFAULT_BOOTLOADER = "u-boot-imx"

UBOOT_DTB_NAME = "imx8mp-icore.dtb"
UBOOT_SUFFIX = "bin"

UBOOT_CONFIG_BASENAME ="imx8mp_icore_1gb"

UBOOT_CONFIG ??= "sd"
UBOOT_CONFIG[sd]	= "${UBOOT_CONFIG_BASENAME}_defconfig,sdcard"

SPL_BINARY = "spl/u-boot-spl.bin"

ATF_PLATFORM = "imx8mp"
ATF_LOAD_ADDR = "0x970000"

# Extra firmware package name, that is required to build boot container for fslc bsp
IMX_EXTRA_FIRMWARE = "firmware-imx-8m"
IMXBOOT_TARGETS_BASENAME = "flash_evk"
IMXBOOT_TARGETS = \
    "${@bb.utils.contains('UBOOT_CONFIG', 'fspi', '${IMXBOOT_TARGETS_BASENAME}_flexspi', \
                                                  '${IMXBOOT_TARGETS_BASENAME}', d)}"

IMX_BOOT_SOC_TARGET = "iMX8MP"

SERIAL_CONSOLES = "115200;ttymxc1"

LOADADDR = ""
UBOOT_SUFFIX = "bin"
UBOOT_MAKE_TARGET = "all"
IMX_BOOT_SEEK = "32"

OPTEE_BIN_EXT = "8mp"
TEE_LOAD_ADDR = "0x56000000"

# Set DDR FIRMWARE
DDR_FIRMWARE_VERSION = "202006"
DDR_FIRMWARE_NAME = " \
	lpddr4_pmu_train_1d_dmem_${DDR_FIRMWARE_VERSION}.bin \
	lpddr4_pmu_train_1d_imem_${DDR_FIRMWARE_VERSION}.bin \
	lpddr4_pmu_train_2d_dmem_${DDR_FIRMWARE_VERSION}.bin \
	lpddr4_pmu_train_2d_imem_${DDR_FIRMWARE_VERSION}.bin \
"
```
