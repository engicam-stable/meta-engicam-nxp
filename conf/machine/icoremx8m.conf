## conf/machine/imx8mp-icore-2e-mac.conf
```bitbake
#@TYPE: Machine
#@NAME: i.MX 8M Plus icore 2 ethernet starterkit 
#@SOC: i.MX8MP
#@DESCRIPTION: Machine configuration for Engicam i.MX 8M Plus icore 2 ethernet starterkit 
#@MAINTAINER: Engicam Support <support@engicam.com>

MACHINEOVERRIDES =. "imx-boot-container:mx8:mx8m:mx8mp:"

require conf/machine/include/imx-base.inc
require conf/machine/include/tune-cortexa53.inc

MACHINE_FEATURES += " pci wifi bluetooth "

ATF_PLATFORM = "imx8mp"
ATF_LOAD_ADDR = "0x970000"
IMX_EXTRA_FIRMWARE = "firmware-imx-8m"

LOADADDR = ""
UBOOT_SUFFIX = "bin"
UBOOT_MAKE_TARGET = "all"
IMX_BOOT_SEEK = "32"

OPTEE_BIN_EXT = "8mp"
TEE_LOAD_ADDR = "0x56000000"

KERNEL_DEVICETREE_BASENAME = "imx8mp-icore"

IMX_KERNEL_CONFIG_AARCH64="imx8mp_icore_defconfig"

KERNEL_DEVICETREE = " \
	engicam/imx8mp-icore-2e-net-mac.dtb \
"
UBOOT_DTB_NAME = "${KERNEL_DEVICETREE_BASENAME}.dtb"

PREFERRED_PROVIDER_virtual/kernel_use-nxp-bsp = "linux-engicam"
PREFERRED_PROVIDER_virtual/bootloader_use-nxp-bsp = "u-boot-engicam"

IMX_DEFAULT_BOOTLOADER = "u-boot-imx"

UBOOT_SUFFIX = "bin"

UBOOT_CONFIG_BASENAME ="imx8mp_icore_2e"

UBOOT_CONFIG ??= "sd"
UBOOT_CONFIG[sd]	= "${UBOOT_CONFIG_BASENAME}_defconfig,sdcard"
SPL_BINARY = "spl/u-boot-spl.bin"

IMXBOOT_TARGETS_BASENAME = "flash_evk"

IMXBOOT_TARGETS = \
    "${@bb.utils.contains('UBOOT_CONFIG', 'fspi', '${IMXBOOT_TARGETS_BASENAME}_flexspi', \
                                                  '${IMXBOOT_TARGETS_BASENAME}', d)}"

IMX_BOOT_SOC_TARGET = "iMX8MP"

DDR_FIRMWARE_VERSION="202006"

DDR_FIRMWARE_NAME = " \
		lpddr4_pmu_train_1d_dmem_${DDR_FIRMWARE_VERSION}.bin \
		lpddr4_pmu_train_1d_imem_${DDR_FIRMWARE_VERSION}.bin \
		lpddr4_pmu_train_2d_dmem_${DDR_FIRMWARE_VERSION}.bin \
		lpddr4_pmu_train_2d_imem_${DDR_FIRMWARE_VERSION}.bin \
"
```

## conf/machine/imx8mp-icore-2e.conf
```bitbake
#@TYPE: Machine
#@NAME: NXP i.MX 8M Plus i.core
#@SOC: i.MX8MP
#@DESCRIPTION: Machine configuration for Engicam imx8mp-icore SOM
#@MAINTAINER: <support@engicam.com>

require include/imx8mp-engicam.inc

MACHINEOVERRIDES =. "mx8-icore:"

KERNEL_DEVICETREE += " \
	engicam/imx8mp-icore-2e-starterkit.dtb \
	engicam/imx8mp-icore-2e-net-phy.dtb \
"

UBOOT_DTB_NAME = "imx8mp-icore-2e.dtb"

UBOOT_CONFIG_BASENAME = "imx8mp_icore_2e"
UBOOT_CONFIG ??= "2gb"
UBOOT_CONFIG[1gb] = "${UBOOT_CONFIG_BASENAME}_1gb_defconfig,sdcard"
UBOOT_CONFIG[2gb] = "${UBOOT_CONFIG_BASENAME}_defconfig,sdcard"
UBOOT_CONFIG[4gb] = "${UBOOT_CONFIG_BASENAME}_4gb_defconfig,sdcard"


# Set DDR FIRMWARE
DDR_FIRMWARE_VERSION = "202006"
DDR_FIRMWARE_NAME = " \
	lpddr4_pmu_train_1d_dmem_${DDR_FIRMWARE_VERSION}.bin \
	lpddr4_pmu_train_1d_imem_${DDR_FIRMWARE_VERSION}.bin \
	lpddr4_pmu_train_2d_dmem_${DDR_FIRMWARE_VERSION}.bin \
	lpddr4_pmu_train_2d_imem_${DDR_FIRMWARE_VERSION}.bin \
"

IMXBOOT_TARGETS_BASENAME = "flash_evk"
IMX_DEFAULT_BSP = "nxp"

ENGICAM_KERNEL_CONFIG_AARCH64 = "imx8_icore_defconfig"
```

## conf/machine/imx8mp-icore-4gb.conf
```bitbake
#@TYPE: Machine
#@NAME: iCore Mx8M Plus
#@SOC: i.MX8M Plus
#@DESCRIPTION: Machine configuration for engicam iCore Mx8M Plus
#@MAINTAINER: engicam support <support@engicam.com>


MACHINEOVERRIDES =. "mx8:mx8m:mx8mp:"

require conf/machine/include/imx-base.inc
require conf/machine/include/tune-cortexa53.inc

MACHINE_FEATURES += " pci wifi bluetooth "
MACHINE_FEATURES_remove_imx    = " nxp8987"

KERNEL_DEVICETREE = "	 engicam/imx8mp-icore.dtb \
			"


UBOOT_CONFIG ??= "sd"
UBOOT_CONFIG[sd] = "imx8mp_icore_4g_defconfig,sdcard"
SPL_BINARY = "spl/u-boot-spl.bin"

# Set DDR FIRMWARE
DDR_FIRMWARE_NAME = "\
			 lpddr4_pmu_train_1d_dmem_202006.bin \
			 lpddr4_pmu_train_1d_imem_202006.bin \
			 lpddr4_pmu_train_2d_dmem_202006.bin \
			 lpddr4_pmu_train_2d_imem_202006.bin \
			 "

IMX_KERNEL_CONFIG_AARCH64 = "imx8mp_icore_defconfig"
KBUILD_DEFCONFIG_mx8= "${IMX_KERNEL_CONFIG_AARCH64}"

# Set u-boot DTB
UBOOT_DTB_NAME = "imx8mp-icore.dtb"

# Set imx-mkimage boot target
IMXBOOT_TARGETS = "${@bb.utils.contains('UBOOT_CONFIG', 'fspi', 'flash_evk_flexspi', 'flash_evk', d)}"

# Set Serial console
SERIAL_CONSOLES = "115200;ttymxc1"

IMAGE_BOOTLOADER = "imx-boot"

LOADADDR = ""
UBOOT_SUFFIX = "bin"
UBOOT_MAKE_TARGET = ""
IMX_BOOT_SEEK = "32"

OPTEE_BIN_EXT = "8mp"

# Add additional firmware
MACHINE_FIRMWARE_append = " linux-firmware-bcm43430"
```

## conf/machine/imx8qxp-icore.conf
```bitbake
#@TYPE: Machine
#@NAME: i.Core MX8X
#@SOC: i.MX8QXP
#@DESCRIPTION: Machine configuration for Engicam imx8qxp-icore SOM
#@MAINTAINER: <support@engicam.com>

require include/imx8qxp-engicam.inc

MACHINEOVERRIDES =. "mx8-icore:"

KERNEL_DEVICETREE += " \
	engicam/imx8qxp-icore-starterkit.dtb \
	engicam/imx8qxp-icore-ctouch2.dtb \
"

UBOOT_DTB_NAME = "imx8qxp-icore.dtb"

UBOOT_CONFIG_BASENAME = "imx8qxp_icore"
UBOOT_CONFIG ??= "sd"
UBOOT_CONFIG[sd] = "${UBOOT_CONFIG_BASENAME}_defconfig,sdcard"

IMX_DEFAULT_BSP = "nxp"

ENGICAM_KERNEL_CONFIG_AARCH64 = "imx8_icore_defconfig"

BOARD_TYPE = "icore"
```

## conf/machine/imx8xd-icore.conf
```bitbake
#@TYPE: Machine
#@NAME: i.MX 8DX Smarcore
#@DESCRIPTION: i.MX 8DX Smarcore
#@MAINTAINER: Engicam <support@engicam.com>

MACHINEOVERRIDES =. "mx8:mx8x:mx8qxp:mx8qxpc0:"

require conf/machine/include/imx-base.inc
require conf/machine/include/tune-cortexa35.inc

MACHINE_FEATURES_append =" pci wifi bluetooth "

# Don't include kernels in standard images
RDEPENDS_${KERNEL_PACKAGE_NAME}-base = ""

LOADADDR = ""


# We have to disable SERIAL_CONSOLE due to auto-serial-console
SERIAL_CONSOLES = "115200;ttyAMA0"

# we do not want to have getty running on tty1 as we run
# auto-serial-console there
USE_VT = "0"

PREFERRED_PROVIDER_virtual/kernel_use-nxp-bsp = "linux-engicam"
PREFERRED_PROVIDER_virtual/bootloader_use-nxp-bsp = "u-boot-engicam"

KERNEL_DEVICETREE = "engicam/imx8xd-icore-starterkit.dtb \
					 engicam/imx8xd-icore-ctouch2-yes7.dtb \
					 engicam/imx8xd-icore-ctouch2.dtb \
					 engicam/imx8xd-icore-starterkit.dtb \
					"



UBOOT_MAKE_TARGET = "u-boot.bin"
UBOOT_SUFFIX = "bin"
UBOOT_CONFIG ??= "sd"
UBOOT_CONFIG[sd] = "imx8xd_icore_defconfig,sdcard"

IMAGE_BOOTLOADER = "imx-boot"
IMX_BOOT_SEEK = "32"

IMXBOOT_TARGETS = \
    "${@bb.utils.contains('UBOOT_CONFIG',   'sd', 'flash', \
        bb.utils.contains('UBOOT_CONFIG', 'fspi', 'flash_flexspi', \
                                                  'UNKNOWN', d), d)}"

IMX_KERNEL_CONFIG_AARCH64 = "imx8x_icore_defconfig"


BOARD_TYPE = "smarcore"

# Add additional firmware
MACHINE_FIRMWARE_append = " linux-firmware-bcm43430"

# Set u-boot DTB
UBOOT_DTB_NAME = "imx8x-icore.dtb"

IMAGE_ROOTFS_SIZE = "2097152"
IMAGE_OVERHEAD_FACTOR = "1.0"
```

## conf/machine/imx8xq-icore.conf
```bitbake
#@TYPE: Machine
#@NAME: i.MX 8X Dual icore tarterkit 
#@SOC: i.MX8XD
#@DESCRIPTION: Machine configuration for Engicam i.MX 8X Dual icore starterkit 
#@MAINTAINER: Engicam Support <support@engicam.com>
MACHINEOVERRIDES =. "mx8:mx8x:mx8qxp:"

require conf/machine/include/imx-base.inc
require conf/machine/include/arm/armv8a/tune-cortexa35.inc

IMX_DEFAULT_BSP = "nxp"

MACHINE_FEATURES += "pci bcm43455 bcm4356"
MACHINE_FEATURES:append:use-nxp-bsp = " bcm4359"

# Don't include kernels in standard images
RDEPENDS:${KERNEL_PACKAGE_NAME}-base = ""

LOADADDR = ""

# We have to disable SERIAL_CONSOLE due to auto-serial-console
SERIAL_CONSOLES = "115200;ttyAMA0"

# we do not want to have getty running on tty1 as we run
# auto-serial-console there
USE_VT = "0"

KERNEL_DEVICETREE_BASENAME = "imx8xq-icore"

IMX_KERNEL_CONFIG_AARCH64="imx8_icore_defconfig"

KERNEL_DEVICETREE:append:use-nxp-bsp = " \
    engicam/${KERNEL_DEVICETREE_BASENAME}-starterkit.dtb \
    engicam/${KERNEL_DEVICETREE_BASENAME}-ctouch2.dtb \
    engicam/${KERNEL_DEVICETREE_BASENAME}-ctouch2-yes7.dtb \
"

UBOOT_MAKE_TARGET = \
    "${@bb.utils.contains('MACHINE_FEATURES', 'optee', '', \
                                                       'u-boot.bin', d)}"
SPL_BINARY = \
    "${@bb.utils.contains('MACHINE_FEATURES', 'optee', 'spl/u-boot-spl.bin', \
                                                       '', d)}"

PREFERRED_PROVIDER_virtual/kernel:use-nxp-bsp = "linux-engicam"

# U-Boot configuration
PREFERRED_PROVIDER_virtual/bootloader:use-nxp-bsp = "u-boot-engicam"
IMX_DEFAULT_BOOTLOADER = "u-boot-imx"

UBOOT_DTB_NAME = "imx8xq-icore.dtb"
UBOOT_SUFFIX = "bin"

UBOOT_CONFIG_BASENAME ="imx8xq_icore"

ATF_PLATFORM = "imx8qx"

IMX_BOOT_SOC_TARGET = "iMX8QX"

UBOOT_CONFIG ??= "sd"
UBOOT_CONFIG[sd]   = "${UBOOT_CONFIG_BASENAME}_defconfig,sdcard"

IMX_BOOT_SEEK = "32"

# This machine is not supported by u-boot-fslc, so we force it to use
# u-boot-imx here.
IMX_DEFAULT_BOOTLOADER = "u-boot-imx"
UBOOT_SUFFIX = "bin"

IMXBOOT_TARGETS_SD = \
    "${@bb.utils.contains('MACHINE_FEATURES', 'optee', 'flash_spl', \
                                                       'flash', d)}"
IMXBOOT_TARGETS_FSPI = \
    "${@bb.utils.contains('MACHINE_FEATURES', 'optee', 'flash_spl_flexspi', \
                                                       'flash_flexspi', d)}"
IMXBOOT_TARGETS = \
    "${@bb.utils.contains('UBOOT_CONFIG',        'sd', '${IMXBOOT_TARGETS_SD}', \
                                                       '${IMXBOOT_TARGETS_FSPI}', d)}"
BOARD_TYPE = "icore"

# Add additional firmware
MACHINE_FIRMWARE:append = " linux-firmware-ath10k"
```

## conf/machine/imx8xq-smarcore.conf
```bitbake
#@TYPE: Machine
#@NAME: i.MX 8QXP Smarcore Openframe X.TOUCH 2.0
#@SOC: i.MX8QXP
#@DESCRIPTION: Machine configuration for i.MX 8QXP Smarcore Openframe X.TOUCH 2.0
#@MAINTAINER: <support@engicam.com>

require include/imx8qxp-engicam.inc

MACHINEOVERRIDES =. "mx8-icore:"

KERNEL_DEVICETREE_BASENAME = "imx8xq-smarcore"

KERNEL_DEVICETREE = " \
    engicam/${KERNEL_DEVICETREE_BASENAME}-xtouch2.dtb \
    engicam/${KERNEL_DEVICETREE_BASENAME}-multimedia-4k.dtb \
"

KERNEL_DEVICETREE:append:use-nxp-bsp = " \
	engicam/${KERNEL_DEVICETREE_BASENAME}-xtouch2.dtb \
    engicam/${KERNEL_DEVICETREE_BASENAME}-multimedia-4k.dtb \
"

UBOOT_DTB_NAME = "imx8x-smarcore-xtouch-2.0.dtb"

UBOOT_CONFIG_BASENAME = "imx8x_smarcore"
UBOOT_CONFIG ??= "sd"
UBOOT_CONFIG[sd] = "${UBOOT_CONFIG_BASENAME}_defconfig,sdcard"

IMX_DEFAULT_BSP = "nxp"

ENGICAM_KERNEL_CONFIG_AARCH64 = "imx8_smarcore_defconfig"

BOARD_TYPE = "smarcore"
```

## conf/machine/include/imx8qxp-engicam.inc
```bitbake
MACHINEOVERRIDES =. "mx8qxp:"

# FIXME: u-boot-imx should be converted to `binman` and then we can
# avoid this specific overrides and handle it in a generic way.
MACHINEOVERRIDES =. "${@bb.utils.contains('IMX_DEFAULT_BOOTLOADER', 'u-boot-imx', '', 'imx-boot-container:', d)}"

require conf/machine/include/imx-base.inc
require conf/machine/include/arm/armv8a/tune-cortexa35.inc

MACHINE_FEATURES += "pci wifi bluetooth"

PREFERRED_PROVIDER_virtual/kernel:mx8-nxp-bsp = "linux-engicam"
PREFERRED_PROVIDER_linux-imx-mfgtool:mx8-nxp-bsp = ""
PREFERRED_PROVIDER_virtual/bootloader:mx8-nxp-bsp = "u-boot-engicam"
PREFERRED_PROVIDER_u-boot:mx8-nxp-bsp = "u-boot-engicam"

IMX_DEFAULT_BOOTLOADER:use-nxp-bsp = "u-boot-imx"

UBOOT_SUFFIX = "bin"

SPL_BINARY = "spl/u-boot-spl.bin"

ATF_PLATFORM = "imx8qx"

IMXBOOT_TARGETS = \
	"${@bb.utils.contains('UBOOT_CONFIG', 'sd', 'flash', \
	bb.utils.contains('UBOOT_CONFIG', 'fspi', 'flash_flexspi', \
							'UNKNOWN', d), d)}"

IMX_BOOT_SOC_TARGET = "iMX8QX"

SERIAL_CONSOLES = "115200;ttymxc1"

LOADADDR = ""
UBOOT_MAKE_TARGET = "all"
IMX_BOOT_SEEK = "32"

# Add additional firmware
MACHINE_FIRMWARE:append = " linux-firmware-ath10k"

KERNEL_IMAGETYPE:mx8-nxp-bsp = "Image"
```
