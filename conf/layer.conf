## conf/machine/imx8ulp-microgea.conf
```bitbake
#@TYPE: Machine
#@NAME: MX8ULP MicroGEA
#@SOC: i.MX8ULP
#@DESCRIPTION: Machine configuration for Engicam MX8ULP MicroGEA boards
#@MAINTAINER: Engicam <support@engicam.com>

require include/imx8ulp.inc

DELTA_KERNEL_DEFCONFIG="${UNPACKDIR}/kernel-config/*"

KERNEL_DEVICETREE:append:use-nxp-bsp = " \
	engicam/imx8ulp-microgea-microdev-lcd7.dtb \
	engicam/imx8ulp-microgea-microdev-rev3.dtb \
	engicam/imx8ulp-microgea-loco5.dtb \
"

UBOOT_CONFIG_BASENAME = "imx8ulp_microgea"

MACHINE_FEATURES += "soc-reva1"
UPOWER_FIRMWARE_NAME = "upower_a1.bin"
IMX_DEFAULT_BSP = "nxp"
```

## conf/machine/imx91-microgea.conf
```bitbake
#@TYPE: Machine
#@NAME: Engicam MicroGEA MX91 boards with LPDDR4
#@SOC: i.MX91
#@DESCRIPTION: Machine configuration for Engicam MicroGEA MX91 boards with LPDDR4
#@MAINTAINER: support <support@engicam.com>

MACHINEOVERRIDES =. "mx91:imx91-icore:imx91-microdev:"

require conf/machine/include/imx91-engicam.inc

DELTA_KERNEL_DEFCONFIG="${UNPACKDIR}/kernel-config/*"

KERNEL_DEVICETREE += " \
    engicam/imx91-microgea-evb.dtb \
    engicam/imx91-microgea-loco5.dtb \
    engicam/imx91-microgea-microdev2-yes7.dtb \
    engicam/imx91-microgea-microdev2.dtb \
    engicam/imx91-microgea-microdev3.dtb \
    engicam/imx91-microgea-starterkit.dtb \
"

UBOOT_CONFIG_BASENAME = "imx91_microgea"

UBOOT_CONFIG ??= "sd"
UBOOT_CONFIG[sd] = "${UBOOT_CONFIG_BASENAME}_defconfig,sdcard"

DDR_FIRMWARE_NAME = " \
    lpddr4_dmem_1d_v202201.bin \
    lpddr4_dmem_2d_v202201.bin \
    lpddr4_imem_1d_v202201.bin \
    lpddr4_imem_2d_v202201.bin \
"
```

## conf/machine/imx93-icore.conf
```bitbake
#@TYPE: Machine
#@NAME: Engicam i.Core MX93 boards with LPDDR4X
#@SOC: i.MX93
#@DESCRIPTION: Machine configuration for Engicam i.Core MX93 boards with LPDDR4X
#@MAINTAINER: <support@engicam.com>

require conf/machine/include/imx93-engicam.inc

DELTA_KERNEL_DEFCONFIG="${UNPACKDIR}/kernel-config/*"

KERNEL_DEVICETREE += " \
        engicam/imx93-icore-ctouch2-amp10.dtb \
        engicam/imx93-icore-ctouch2.dtb \
        engicam/imx93-icore-ctouch3.1-yes7.dtb \
        engicam/imx93-icore-ctouch3.1.dtb \
        engicam/imx93-icore-starterkit.dtb \
"

UBOOT_CONFIG_BASENAME = "imx93_icore"
UBOOT_CONFIG ??= "2gb"
UBOOT_CONFIG[1gb] = "${UBOOT_CONFIG_BASENAME}_1gb_defconfig,sdcard"
UBOOT_CONFIG[2gb] = "${UBOOT_CONFIG_BASENAME}_defconfig,sdcard"

IMXBOOT_TARGETS_BASENAME = "flash_singleboot"

DDR_FIRMWARE_NAME = " \
    lpddr4_dmem_1d_v202201.bin \
    lpddr4_dmem_2d_v202201.bin \
    lpddr4_imem_1d_v202201.bin \
    lpddr4_imem_2d_v202201.bin \
"

UBOOT_CONFIG[fspi]   = "${UBOOT_CONFIG_BASENAME}_defconfig"

IMXBOOT_TARGETS = "${@bb.utils.contains('UBOOT_CONFIG', 'fspi', '${IMXBOOT_TARGETS_BASENAME}_flexspi', '${IMXBOOT_TARGETS_BASENAME}', d)}"
```

## conf/machine/imx95-icore.conf
```bitbake
#@TYPE: Machine
#@NAME: NXP i.MX 95 19x19 Evaluation Kit with LPDDR5
#@SOC: i.MX95
#@DESCRIPTION: Machine configuration for NXP i.MX 95 19x19 EVK with LPDDR5
#@MAINTAINER: Jun Zhu <junzhu@nxp.com>

MACHINEOVERRIDES =. "mx95:mx95-icore:"

require include/imx95-engicam.inc

ENGICAM_KERNEL_CONFIG_AARCH64 = "imx95_icore_defconfig"
KERNEL_DEVICETREE:append:use-nxp-bsp = " \
    engicam/imx95-icore-starterkit.dtb \
"

UBOOT_CONFIG ??= "sd"
UBOOT_CONFIG[sd] = "imx95_icore_defconfig,sdcard"

IMXBOOT_TARGETS_BASENAME = "flash"
OEI_BOARD  = "mx95lp5"
DDR_TYPE   = "lpddr5"
DDR_CONFIG   = "lpddr5_4gb_3200mts_train_timing"

DDR_FIRMWARE_NAME = " \
    lpddr5_dmem_v202311.bin \
    lpddr5_dmem_qb_v202311.bin \
    lpddr5_imem_v202311.bin \
    lpddr5_imem_qb_v202311.bin \
"
M4_DEFAULT_IMAGE_MX95 = "${@bb.utils.contains('SYSTEM_MANAGER_CONFIG', 'mx95netc', 'imx95-19x19-evk_m7_TCM_netc_share.bin', \
                                                                                   'imx95-19x19-evk_m7_TCM_power_mode_switch.bin', d)}"
PREFERRED_RPROVIDER_wpa-supplicant = "summit-supplicant-lwb-if"
PREFERRED_RPROVIDER_wpa-supplicant-cli = "summit-supplicant-lwb-if"
PREFERRED_RPROVIDER_wpa-supplicant-passphrase = "summit-supplicant-lwb-if"
PREFERRED_RPROVIDER_wireless-regdb-static = "wireless-regdb"
```

## conf/machine/imx95-smarcore.conf
```bitbake
#@TYPE: Machine
#@NAME: NXP i.MX 95 19x19 Evaluation Kit with LPDDR5
#@SOC: i.MX95
#@DESCRIPTION: Machine configuration for NXP i.MX 95 19x19 EVK with LPDDR5
#@MAINTAINER: Jun Zhu <junzhu@nxp.com>

MACHINEOVERRIDES =. "mx95:mx95-smarcore:"
MACHINE_FEATURES:remove = "nxpwifi-all-pcie nxpwifi-all-sdio"

require conf/machine/include/imx95-engicam.inc

DELTA_KERNEL_DEFCONFIG="${UNPACKDIR}/kernel-config/*"

KERNEL_DEVICETREE:append:use-nxp-bsp = " \
    engicam/imx95-smarcore-smarcore-evb.dtb \
    engicam/imx95-smarcore-xtouch2.dtb \ 
    engicam/imx95-smarcore-multimedia-4k.dtb \     
"

UBOOT_CONFIG ??= "sd"
UBOOT_CONFIG[sd] = "imx95_smarcore_defconfig,sdcard"
#UBOOT_CONFIG[sd] = "imx95smarc"

IMXBOOT_TARGETS_BASENAME = "flash"
OEI_BOARD  = "mx95lp5"
DDR_TYPE   = "lpddr5"
IMX_SOC_REV:${MACHINE} = "B0"
#IMX_SOC_REV:${MACHINE} = "A0"

OEI_DDR_CONFIG = "lpddr5_4gb_6400mts_train_timing"
SYSTEM_MANAGER_CONFIG = "mx95evk"

DDR_FIRMWARE_NAME = " \
    lpddr5_dmem_v202409.bin \
    lpddr5_dmem_qb_v202409.bin \
    lpddr5_imem_v202409.bin \
    lpddr5_imem_qb_v202409.bin \
"

M4_DEFAULT_IMAGE_MX95 = "${@bb.utils.contains('SYSTEM_MANAGER_CONFIG', 'mx95netc', 'imx95-19x19-evk_m7_TCM_netc_share.bin', \
                                                                                   'imx95-19x19-evk_m7_TCM_power_mode_switch.bin', d)}"

PREFERRED_PROVIDER_wpa-supplicant = "summit-supplicant"
PREFERRED_RPROVIDER_wpa-supplicant = "summit-supplicant"
PREFERRED_RPROVIDER_wpa-supplicant-cli = "summit-supplicant"
PREFERRED_RPROVIDER_wpa-supplicant-passphrase = "summit-supplicant"
PREFERRED_RPROVIDER_wireless-regdb-static = "wireless-regdb"
```

## conf/machine/include/imx91-engicam.inc
```bitbake
require conf/machine/include/imx-base.inc
require conf/machine/include/arm/armv8-2a/tune-cortexa55.inc

MACHINE_FEATURES += "pci wifi bluetooth"
MACHINE_FEATURES:append:use-nxp-bsp = " dpdk optee nxpwifi-all-sdio bcm43430 nxp8987-sdio"

UBOOT_DTB_NAME = "imx91-microgea.dtb"

IMX_DEFAULT_BOOTLOADER:use-nxp-bsp = "u-boot-imx"
IMX_DEFAULT_BOOTLOADER:use-mainline-bsp = "u-boot-fslc"

LOADADDR = ""
UBOOT_SUFFIX = "bin"
UBOOT_MAKE_TARGET = ""

SPL_BINARY = "spl/u-boot-spl.bin"

# Set ATF platform name
ATF_PLATFORM = "imx91"

IMXBOOT_TARGETS = "flash_singleboot"

IMX_BOOT_SOC_TARGET = "iMX91"
IMX_BOOT_SEEK = "32"

# We have to disable SERIAL_CONSOLE due to auto-serial-console
SERIAL_CONSOLES = "115200;ttyLP0"

IMX_DEFAULT_BSP = "nxp"

MACHINE_FIRMWARE:append = " linux-firmware-bcm4373"
```

## conf/machine/include/imx95-engicam.inc
```bitbake
require conf/machine/include/imx-base.inc
require conf/machine/include/arm/armv8-2a/tune-cortexa55.inc

MACHINE_FEATURES += "pci wifi bluetooth optee bcm43430"
MACHINE_FEATURES:append:use-nxp-bsp = " nxpwifi-all-pcie nxpwifi-all-sdio jailhouse dpdk xen"

IMX_DEFAULT_BOOTLOADER:use-nxp-bsp = "u-boot-imx"
IMX_DEFAULT_BOOTLOADER:use-mainline-bsp = "u-boot-fslc"

LOADADDR = ""
UBOOT_SUFFIX = "bin"
UBOOT_MAKE_TARGET = ""

SPL_BINARY = "spl/u-boot-spl.bin"

UBOOT_CONFIG ??= "sd"
UBOOT_CONFIG[sd] = "${UBOOT_CONFIG_BASENAME}_defconfig,sdcard"


ATF_PLATFORM = "imx95"

OEI_CORE   = "m33"
OEI_SOC    = "mx95"
OEI_BOARD  = "mx95lp5"

DDR_TYPE   = "lpddr5"


# imx-boot (flash.bin) targets based on UBOOT_CONFIG and IMXBOOT_VARIANT
IMXBOOT_TARGETS_SD = '${IMXBOOT_TARGETS_BASENAME}_all ${IMXBOOT_TARGETS_BASENAME}_a55'

IMXBOOT_TARGETS = " \
    ${@bb.utils.contains('UBOOT_CONFIG', 'fspi',   '${IMXBOOT_TARGETS_BASENAME}_a55_flexspi', \
       bb.utils.contains('UBOOT_CONFIG', 'sd-ecc', '${IMXBOOT_TARGETS_BASENAME}_all', \
                                                   '${IMXBOOT_TARGETS_SD}', d), d)} \
"

IMX_BOOT_SOC_TARGET = "iMX95"
IMX_BOOT_SEEK = "32"

# We have to disable SERIAL_CONSOLE due to auto-serial-console
SERIAL_CONSOLES = "115200;ttyLP0"

IMX_DEFAULT_BSP = "nxp"
```
